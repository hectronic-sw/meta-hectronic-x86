## conf/machine/h6075.conf
```bitbake
#@TYPE: Machine
#@NAME: Hectronic H6075
#@DESCRIPTION: Machine configuration for H6075
#@MAINTAINER: Jonas Antoni <jonas.antoni@hectronic.se>

MACHINEOVERRIDES =. "h6075:"

require conf/machine/include/h6075.inc
```
